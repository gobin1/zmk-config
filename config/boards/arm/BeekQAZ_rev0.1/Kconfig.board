## config/boards/arm/BeekQAZ_rev0.1/Kconfig.board
```kconfig
# BeekQAZ rev1 board configuration

# Copyright (c) 2020 The ZMK Contributors
# SPDX-License-Identifier: MIT

config BOARD_BEEKQAZ_REV1
	bool "BeekQAZ_rev1 Keyboard"
	depends on SOC_NRF52840_QIAA
```

## config/boards/arm/BeekQAZ_rev1/BeekQAZ_rev1_defconfig
```kconfig
# SPDX-License-Identifier: MIT

CONFIG_SOC_SERIES_NRF52X=y
CONFIG_SOC_NRF52840_QIAA=y
CONFIG_BOARD_BEEKQAZ_REV1=y

# Enable MPU
CONFIG_ARM_MPU=y

# enable GPIO
CONFIG_GPIO=y

CONFIG_USE_DT_CODE_PARTITION=y

CONFIG_MPU_ALLOW_FLASH_WRITE=y
CONFIG_NVS=y
CONFIG_SETTINGS_NVS=y
CONFIG_FLASH=y
CONFIG_FLASH_PAGE_LAYOUT=y
CONFIG_FLASH_MAP=y

# Enable Underglow
CONFIG_ZMK_RGB_UNDERGLOW=n
CONFIG_WS2812_STRIP=n

# Enable the rotary encoder
CONFIG_EC11=n
CONFIG_EC11_TRIGGER_GLOBAL_THREAD=n

# Build change in zephyr 3
CONFIG_BUILD_OUTPUT_UF2=y

# Enable control of external power
CONFIG_ZMK_EXT_POWER	
```
